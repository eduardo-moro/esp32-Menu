## sdkconfig.defaults
```kconfig
# Required for Arduino compatibility
CONFIG_FREERTOS_HZ=1000

# Recommended additional settings
CONFIG_FREERTOS_USE_TICKLESS_IDLE=n
CONFIG_FREERTOS_ASSERT_ON_UNTESTED_FUNCTION=y
```
